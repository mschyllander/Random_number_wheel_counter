## CMakeLists.txt
```
cmake_minimum_required(VERSION 3.20.0)

set(ZEPHYR_EXTRA_MODULES "${CMAKE_SOURCE_DIR}/../../modules/say_hello")

find_package(Zephyr REQUIRED HINTS $ENV{ZEPHYR_BASE})

project(random)

target_sources(app PRIVATE
    src/main.c
    src/screen.c
    src/digit_font.c
    src/st7735.c
    src/matrix.c
    src/number_wheels.c
)
```

## prj.conf
```kconfig
#CONFIG_STACK_CANARIES is not set
CONFIG_STACK_POINTER_RANDOM=0
CONFIG_TEST_RANDOM_GENERATOR=y
CONFIG_TIMER_RANDOM_GENERATOR=y
CONFIG_TEST_CSPRNG_GENERATOR=y

CONFIG_GPIO=y
CONFIG_SPI=y
CONFIG_PRINTK=y
```

## src/main.c
```c
#include <zephyr/kernel.h>
#include <zephyr/random/random.h>
#include <zephyr/sys/printk.h>
#include <stdint.h>
#include "screen.h"
#include "matrix.h"
#include "st7735.h"
#include "number_wheels.h"

#define HOLD_TIME_MS 2500

int main(void)
{
    st7735_init();
    matrix_init(SCREEN_WIDTH, SCREEN_HEIGHT);
    number_wheels_init(SCREEN_WIDTH, SCREEN_HEIGHT);

    int64_t next_spin = 0;
    bool was_spinning = false;

    while (1) {
        int64_t now = k_uptime_get();
        bool busy = number_wheels_busy(now);

        if (was_spinning && !busy) {
            next_spin = now + HOLD_TIME_MS;
        }

        if (!busy && now >= next_spin) {
            uint32_t rnd = sys_rand32_get() % 1000000U;
            number_wheels_start(rnd, now);
            printk("New target: %06u\n", (unsigned int)rnd);
            busy = true;
        }
        was_spinning = busy;

        screen_clear();
        matrix_update_and_draw(screen_pixel);
        number_wheels_draw(screen_pixel, now);
        screen_present();
        /* Bildöverföringen tar redan tid; håll extra väntan kort för jämnare rörelse. */
        k_msleep(8);
    }
    return 0;
}
```

## src/digit_font.c
```c
#include "digit_font.h"

const uint8_t digit_font[10][5] = {

    // 0
    {0x3E, 0x41, 0x41, 0x41, 0x3E},
    // 1
    {0x00, 0x42, 0x7F, 0x40, 0x00},
    // 2
    {0x62, 0x51, 0x49, 0x49, 0x46},
    // 3
    {0x22, 0x41, 0x49, 0x49, 0x36},
    // 4
    {0x18, 0x14, 0x12, 0x7F, 0x10},
    // 5
    {0x2F, 0x49, 0x49, 0x49, 0x31},
    // 6
    {0x3E, 0x49, 0x49, 0x49, 0x32},
    // 7
    {0x01, 0x61, 0x11, 0x09, 0x07},
    // 8
    {0x36, 0x49, 0x49, 0x49, 0x36},
    // 9
    {0x26, 0x49, 0x49, 0x49, 0x3E}
};
```

## src/digit_font.h
```c
#ifndef DIGIT_FONT_H
#define DIGIT_FONT_H
#include <stdint.h>
extern const uint8_t digit_font[10][5];
#endif
```

## src/matrix.c
```c
#include "digit_font.h"
#include "matrix.h"
#include <zephyr/random/random.h>

#define MAX_COLUMNS 20
#define COLUMN_SPACING 8
#define CHAR_HEIGHT 8
#define TRAIL_LENGTH 8

struct rain_column {
    int x;
    int y;
    int speed;
    uint8_t digits[TRAIL_LENGTH];
};

static struct rain_column columns[MAX_COLUMNS];
static int column_count;
static int screen_height;

/* Små siffror, 5 × 7 pixlar. */


static void randomize_digits(struct rain_column *column)
{
    for (int i = 0; i < TRAIL_LENGTH; i++) {
        column->digits[i] = sys_rand32_get() % 10U;
    }
}

void matrix_init(int width, int height)
{
    screen_height = height;

    column_count = width / COLUMN_SPACING;

    if (column_count > MAX_COLUMNS) {
        column_count = MAX_COLUMNS;
    }

    if (width <= 0 || height <= 0) {
        column_count = 0;
        return;
    }

    for (int i = 0; i < column_count; i++) {
        columns[i].x = i * COLUMN_SPACING + 1;

        /* Sprid ut starten ovanför och inne på skärmen. */
        columns[i].y =
            (int)(sys_rand32_get() % (uint32_t)(height * 2))
            - height;

        columns[i].speed = 1 + sys_rand32_get() % 3U;

        randomize_digits(&columns[i]);
    }
}

static void draw_digit(matrix_pixel_fn draw_pixel,
                       int x, int y,
                       uint8_t digit, uint16_t color)
{
    for (int col = 0; col < 5; col++) {
        uint8_t bits = digit_font[digit][col];

        for (int row = 0; row < 7; row++) {
            if (bits & (1U << row)) {
                draw_pixel(x + col, y + row, color);
            }
        }
    }
}

void matrix_update_and_draw(matrix_pixel_fn draw_pixel)
{
    for (int i = 0; i < column_count; i++) {
        struct rain_column *column = &columns[i];

        column->y += column->speed;

        /* Starta om när hela svansen har lämnat bilden. */
        if (column->y >=
            screen_height + TRAIL_LENGTH * CHAR_HEIGHT) {
            column->y =
                -CHAR_HEIGHT - (int)(sys_rand32_get() % 64U);

            column->speed = 1 + sys_rand32_get() % 3U;
            randomize_digits(column);
        }

        /* Ändra ett tecken ibland för lite liv i regnet. */
        if (sys_rand32_get() % 12U == 0) {
            int index = sys_rand32_get() % TRAIL_LENGTH;
            column->digits[index] = sys_rand32_get() % 10U;
        }

        for (int j = 0; j < TRAIL_LENGTH; j++) {
            int y = column->y - j * CHAR_HEIGHT;
            if (y >= screen_height || y + 7 <= 0) {
                continue;
            }
            uint16_t color;

            if (j == 0) {
                /* Ljust grönt huvud. */
                color = 006400; // old value: 0xBFF7
            } else {
                /* Grönt med avtagande ljusstyrka, RGB565. */
                uint16_t green =
                    63U * (TRAIL_LENGTH - j) / TRAIL_LENGTH;

                color = (uint16_t)(green << 5);
            }

            draw_digit(draw_pixel,
                       column->x, y,
                       column->digits[j], color);
        }
    }
}
```

## src/matrix.h
```c
#ifndef MATRIX_H
#define MATRIX_H

#include <stdint.h>

typedef void (*matrix_pixel_fn)(int x, int y, uint16_t color);

void matrix_init(int width, int height);
void matrix_update_and_draw(matrix_pixel_fn draw_pixel);

#endif
```

## src/number_wheels.c
```c
#include "digit_font.h"
#include "number_wheels.h"

#define WHEEL_COUNT 6
#define SCALE 4
#define PITCH 36
#define CELL_WIDTH 25
#define WINDOW_HEIGHT 64
#define SPIN_MS 1400
#define STOP_GAP_MS 220
#define UNIT 256

struct wheel {
    int digit;
    int steps;
};

static struct wheel wheels[WHEEL_COUNT];
static int origin_x;
static int center_y;
static int64_t started;
static bool spinning;



static uint16_t gray(int level)
{
    return (uint16_t)(((level >> 3) << 11) |
                      ((level >> 2) << 5) | (level >> 3));
}

void number_wheels_init(int width, int height)
{
    origin_x = (width - WHEEL_COUNT * CELL_WIDTH) / 2;
    center_y = height / 2;
    spinning = false;
    for (int i = 0; i < WHEEL_COUNT; i++) {
        wheels[i].digit = 0;
        wheels[i].steps = 0;
    }
}

bool number_wheels_busy(int64_t now)
{
    return spinning &&
           now - started < SPIN_MS + (WHEEL_COUNT - 1) * STOP_GAP_MS;
}

/* Start only after the preceding spin has finished. */
void number_wheels_start(uint32_t number, int64_t now)
{
    if (number_wheels_busy(now)) {
        return;
    }

    for (int i = WHEEL_COUNT - 1; i >= 0; i--) {
        struct wheel *w = &wheels[i];
        w->digit = (w->digit + w->steps) % 10;
        int target = number % 10U;
        number /= 10U;

        /* Full turns followed by the distance to the target digit. */
        w->steps = 20 + i * 10 + (target - w->digit + 10) % 10;
    }
    started = now;
    spinning = true;
}

void number_wheels_draw(wheels_pixel_fn pixel, int64_t now)
{
    int top = center_y - WINDOW_HEIGHT / 2;
    int bottom = top + WINDOW_HEIGHT;

    for (int i = 0; i < WHEEL_COUNT; i++) {
        struct wheel *w = &wheels[i];
        int left = origin_x + i * CELL_WIDTH;
        int position = w->digit * PITCH * UNIT;

        if (spinning) {
            int duration = SPIN_MS + i * STOP_GAP_MS;
            int64_t elapsed = now - started;
            if (elapsed < 0) {
                elapsed = 0;
            }
            if (elapsed > duration) {
                elapsed = duration;
            }

            /* Cubic easing: quick start, gradual stop. Integer arithmetic. */
            int64_t remaining = (duration - elapsed) * 1024 / duration;
            int64_t ease = 1024 -
                remaining * remaining * remaining / (1024 * 1024);
            position += (int)((int64_t)w->steps * PITCH * UNIT *
                              ease / 1024);
        }

        int base = position / (PITCH * UNIT);
        int offset = (position / UNIT) % PITCH;

        /* Neighbouring digits are clipped at the wheel's window. */
        for (int neighbour = -1; neighbour <= 2; neighbour++) {
            int digit = (base + neighbour + 10) % 10;
            int digit_y = center_y - 7 * SCALE / 2 +
                          neighbour * PITCH - offset;

            for (int col = 0; col < 5; col++) {
                for (int row = 0; row < 7; row++) {
                    if (!(digit_font[digit][col] & (1U << row))) {
                        continue;
                    }
                    for (int dy = 0; dy < SCALE; dy++) {
                        int y = digit_y + row * SCALE + dy;
                        if (y <= top || y >= bottom - 1) {
                            continue;
                        }
                        int distance = y - center_y;
                        if (distance < 0) {
                            distance = -distance;
                        }
                        int brightness = distance <= 14 ? 255 :
                                         255 - (distance - 14) * 12;
                        for (int dx = 0; dx < SCALE; dx++) {
                            pixel(left + 2 + col * SCALE + dx, y,
                                  gray(brightness));
                        }
                    }
                }
            }
        }
    }
}
```

## src/number_wheels.h
```c
#ifndef NUMBER_WHEELS_H
#define NUMBER_WHEELS_H

#include <stdbool.h>
#include <stdint.h>

typedef void (*wheels_pixel_fn)(int x, int y, uint16_t color);

void number_wheels_init(int width, int height);
void number_wheels_start(uint32_t number, int64_t now);
void number_wheels_draw(wheels_pixel_fn pixel, int64_t now);
bool number_wheels_busy(int64_t now);

#endif
```

## src/screen.c
```c
#include "screen.h"
#include <string.h>

/* Store RGB565 high byte first, ready for the synchronous SPI transfer.
 * Only this module owns the image and landscape coordinate conversion. */
static uint8_t framebuffer[ST7735_WIDTH * ST7735_HEIGHT * 2];

void screen_clear(void)
{
    memset(framebuffer, 0, sizeof(framebuffer));
}

void screen_pixel(int x, int y, uint16_t color)
{
    if (x < 0 || x >= SCREEN_WIDTH || y < 0 || y >= SCREEN_HEIGHT) {
        return;
    }
    int physical_x = ST7735_WIDTH - 1 - y;
    int index = 2 * (x * ST7735_WIDTH + physical_x);
    framebuffer[index] = (uint8_t)(color >> 8);
    framebuffer[index + 1] = (uint8_t)color;
}

void screen_present(void)
{
    st7735_draw_frame_bytes(framebuffer);
}
```

## src/screen.h
```c
#ifndef SCREEN_H
#define SCREEN_H

#include <stdint.h>
#include "st7735.h"

#define SCREEN_WIDTH ST7735_HEIGHT
#define SCREEN_HEIGHT ST7735_WIDTH

void screen_clear(void);
void screen_pixel(int x, int y, uint16_t color);
void screen_present(void);

#endif
```

## src/st7735.c
```c
#include "st7735.h"

#include <zephyr/kernel.h>
#include <zephyr/device.h>
#include <zephyr/drivers/gpio.h>
#include <zephyr/drivers/spi.h>
#include <zephyr/sys/printk.h>
#include <stddef.h>

#define PIN_DC   2
#define PIN_RST  0
#define PIN_CS   1

static const struct device *gpio = DEVICE_DT_GET(DT_NODELABEL(gpio0));
static const struct device *spi = DEVICE_DT_GET(DT_NODELABEL(spi2));

static struct spi_config spi_cfg = {
    /* ST7735-modulen klarar normalt 40 MHz SPI; halverar överföringstiden. */
    .frequency = 40000000,
    .operation = SPI_OP_MODE_MASTER | SPI_WORD_SET(8) | SPI_TRANSFER_MSB,
    .slave = 0,
};

static int st7735_write(const uint8_t *data, size_t len)
{
    struct spi_buf buf = {
        .buf = (void *)data,
        .len = len,
    };

    struct spi_buf_set tx = {
        .buffers = &buf,
        .count = 1,
    };

    return spi_write(spi, &spi_cfg, &tx);
}

static void st7735_cmd(uint8_t cmd)
{
    gpio_pin_set(gpio, PIN_DC, 0);
    gpio_pin_set(gpio, PIN_CS, 0);
    st7735_write(&cmd, 1);
    gpio_pin_set(gpio, PIN_CS, 1);
}

static void st7735_data(const uint8_t *data, size_t len)
{
    gpio_pin_set(gpio, PIN_DC, 1);
    gpio_pin_set(gpio, PIN_CS, 0);
    st7735_write(data, len);
    gpio_pin_set(gpio, PIN_CS, 1);
}

static void st7735_data8(uint8_t data)
{
    st7735_data(&data, 1);
}

static void st7735_reset(void)
{
    gpio_pin_set(gpio, PIN_RST, 1);
    k_msleep(50);

    gpio_pin_set(gpio, PIN_RST, 0);
    k_msleep(100);

    gpio_pin_set(gpio, PIN_RST, 1);
    k_msleep(150);
}

static void st7735_set_window(uint8_t x0, uint8_t y0, uint8_t x1, uint8_t y1)
{
    uint8_t data[4];

    st7735_cmd(0x2A);
    data[0] = 0x00;
    data[1] = x0;
    data[2] = 0x00;
    data[3] = x1;
    st7735_data(data, 4);

    st7735_cmd(0x2B);
    data[0] = 0x00;
    data[1] = y0;
    data[2] = 0x00;
    data[3] = y1;
    st7735_data(data, 4);

    st7735_cmd(0x2C);
}

void st7735_init(void)
{
    if (!device_is_ready(gpio)) {
        printk("ST7735 GPIO not ready\n");
        return;
    }

    if (!device_is_ready(spi)) {
        printk("ST7735 SPI not ready\n");
        return;
    }

    gpio_pin_configure(gpio, PIN_DC, GPIO_OUTPUT_INACTIVE);
    gpio_pin_configure(gpio, PIN_RST, GPIO_OUTPUT_ACTIVE);
    gpio_pin_configure(gpio, PIN_CS, GPIO_OUTPUT_ACTIVE);

    st7735_reset();

    st7735_cmd(0x01);      // software reset
    k_msleep(150);

    st7735_cmd(0x11);      // sleep out
    k_msleep(150);

    st7735_cmd(0x3A);      // color mode
    st7735_data8(0x05);    // RGB565

    st7735_cmd(0x36);      // MADCTL
    st7735_data8(0x00);

    st7735_cmd(0x20);      // inversion OFF
    k_msleep(10);

    st7735_cmd(0x13);      // normal display mode ON
    k_msleep(10);

    st7735_cmd(0x29);      // display ON
    k_msleep(150);
}

void st7735_fill(uint16_t color)
{
    uint8_t pixel[2] = {
        (uint8_t)(color >> 8),
        (uint8_t)(color & 0xFF)
    };

    st7735_set_window(0, 0, ST7735_WIDTH - 1, ST7735_HEIGHT - 1);

    gpio_pin_set(gpio, PIN_DC, 1);
    gpio_pin_set(gpio, PIN_CS, 0);

    for (int i = 0; i < ST7735_WIDTH * ST7735_HEIGHT; i++) {
        st7735_write(pixel, 2);
    }

    gpio_pin_set(gpio, PIN_CS, 1);
}

void st7735_draw_pixel(uint8_t x, uint8_t y, uint16_t color)
{
    if (x >= ST7735_WIDTH || y >= ST7735_HEIGHT) {
        return;
    }

    uint8_t pixel[2] = {
        (uint8_t)(color >> 8),
        (uint8_t)(color & 0xFF)
    };

    st7735_set_window(x, y, x, y);
    st7735_data(pixel, 2);
}

/* The caller supplies one complete RGB565 image, high byte first.
 * spi_write is synchronous, so the image may be reused after return. */
void st7735_draw_frame_bytes(const uint8_t *buffer)
{
    st7735_set_window(0, 0, ST7735_WIDTH - 1, ST7735_HEIGHT - 1);
    st7735_data(buffer, ST7735_WIDTH * ST7735_HEIGHT * 2);
}

/* Compatibility for callers with native uint16_t pixels.
 * Convert a row at a time instead of allocating another full image. */
void st7735_draw_framebuffer(const uint16_t *buffer)
{
    uint8_t row[ST7735_WIDTH * 2];
    st7735_set_window(0, 0, ST7735_WIDTH - 1, ST7735_HEIGHT - 1);
    gpio_pin_set(gpio, PIN_DC, 1);
    gpio_pin_set(gpio, PIN_CS, 0);

    for (int y = 0; y < ST7735_HEIGHT; y++) {
        for (int x = 0; x < ST7735_WIDTH; x++) {
            uint16_t color = buffer[y * ST7735_WIDTH + x];
            row[2 * x] = (uint8_t)(color >> 8);
            row[2 * x + 1] = (uint8_t)color;
        }
        if (st7735_write(row, sizeof(row)) < 0) {
            break;
        }
    }
    gpio_pin_set(gpio, PIN_CS, 1);
}
```

## src/st7735.h
```c
#ifndef ST7735_H
#define ST7735_H

#include <stdint.h>

#define ST7735_WIDTH   128
#define ST7735_HEIGHT  160

#define ST7735_BLACK   0x0000
#define ST7735_WHITE   0xFFFF
#define ST7735_RED     0xF800
#define ST7735_GREEN   0x07E0
#define ST7735_BLUE    0x001F

void st7735_init(void);
void st7735_fill(uint16_t color);
void st7735_draw_pixel(uint8_t x, uint8_t y, uint16_t color);
void st7735_draw_frame_bytes(const uint8_t *buffer);
void st7735_draw_framebuffer(const uint16_t *buffer);

#endif
```

## src/stars.c
```c
#include "stars.h"
#include <zephyr/random/random.h>

#define STAR_COUNT 40

struct star {
    int x;
    int y;
    int speed;
    uint16_t color;
};

static struct star stars[STAR_COUNT];

static int screen_width;
static int screen_height;

void stars_init(int width, int height)
{
    screen_width = width;
    screen_height = height;

    for (int i = 0; i < STAR_COUNT; i++) {
        stars[i].x = sys_rand32_get() % screen_width;
        stars[i].y = sys_rand32_get() % screen_height;

        /* Tre lager med olika hastighet och ljusstyrka. */
        stars[i].speed = 1 + (i % 3);

        switch (stars[i].speed) {
        case 1:
            stars[i].color = 0x4208; /* Mörkgrå */
            break;

        case 2:
            stars[i].color = 0x8410; /* Grå */
            break;

        default:
            stars[i].color = 0xFFFF; /* Vit */
            break;
        }
    }
}

void stars_update_and_draw(stars_pixel_fn draw_pixel)
{
    for (int i = 0; i < STAR_COUNT; i++) {
        struct star *s = &stars[i];

        /* Minska x för att flytta åt vänster. */
        s->x -= s->speed;

        /* Börja om på höger sida. */
        if (s->x < 0) {
            s->x += screen_width;
            s->y = sys_rand32_get() % screen_height;
        }

        draw_pixel(s->x, s->y, s->color);
    }
}
```

## src/stars.h
```c
#ifndef STARS_H
#define STARS_H

#include <stdint.h>

/* Funktion som kan rita en pixel. */
typedef void (*stars_pixel_fn)(int x, int y, uint16_t color);

void stars_init(int width, int height);
void stars_update_and_draw(stars_pixel_fn draw_pixel);

#endif
```
